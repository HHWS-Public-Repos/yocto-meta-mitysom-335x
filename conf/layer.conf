## conf/layer.conf
```bitbake
# We have a conf and classes directory, add to BBPATH
BBPATH .= ":${LAYERDIR}"

# We have a recipes-* directories, add to BBFILES
BBFILES += "${LAYERDIR}/recipes-*/*/*.bb \
	${LAYERDIR}/recipes-*/*/*.bbappend"

BBFILE_COLLECTIONS += "mitysom-335x"
BBFILE_PATTERN_mitysom-335x = "^${LAYERDIR}/"
BBFILE_PRIORITY_mitysom-335x = "50"
```

## conf/machine/mitysom-335x-1GB.conf
```bitbake
#@TYPE: Machine
#@NAME: mitysom-335x-1GB
require conf/machine/mitysom-335x.conf

PREFERRED_PROVIDER_virtual/bootloader = "u-boot-mitysom-1GB-335x"
PREFERRED_PROVIDER_u-boot = "u-boot-mitysom-1GB-335x"

MKUBIFS_ARGS = " -F -m 4096 -e 516096 -c 2028 "
UBINIZE_ARGS = " -p 512KiB -m 4096 -s 4096 "
```

## conf/machine/mitysom-335x-512MB.conf
```bitbake
#@TYPE: Machine
#@NAME: mitysom-335x-512MB
require conf/machine/mitysom-335x.conf

PREFERRED_PROVIDER_virtual/bootloader = "u-boot-mitysom-512MB-335x"
PREFERRED_PROVIDER_u-boot = "u-boot-mitysom-512MB-335x"

MKUBIFS_ARGS = " -F -m 4096 -e 253952 -c 1580 "
UBINIZE_ARGS = " -p 256KiB -m 4096 -s 4096 "
```

## conf/machine/mitysom-335x-USBBOOT.conf
```bitbake
#@TYPE: Machine
#@NAME: mitysom-335x-512MB
require conf/machine/mitysom-335x.conf

PREFERRED_PROVIDER_virtual/bootloader = "u-boot-mitysom-usb-boot-335x"
PREFERRED_PROVIDER_u-boot = "u-boot-mitysom-usb-boot-335x"
```

## conf/machine/mitysom-335x-maker.conf
```bitbake
#@TYPE: Machine
#@NAME: mitysom-335x-maker
require conf/machine/mitysom-335x.conf

PREFERRED_PROVIDER_virtual/bootloader = "u-boot-mitysom-maker-335x"
PREFERRED_PROVIDER_u-boot = "u-boot-mitysom-maker-335x"
```

## conf/machine/mitysom-335x.conf
```bitbake
#@TYPE: Machine
#@NAME: mitysom-335x

#@DESCRIPTION: Machine configuration for mitysom-335x systems
SOC_FAMILY = "ti-soc:ti33x"
require conf/machine/include/soc-family.inc

MACHINE_DISPLAYNAME = "MitySOM 335x"

PREFERRED_PROVIDER_virtual/xserver ?= "xserver-xorg"
XSERVER ?= "xserver-xorg \
           xf86-input-evdev \
           xf86-input-mouse \
           xf86-video-fbdev \
           xf86-input-keyboard \
           xf86-input-tslib"

# Ship all kernel modules by default
MACHINE_EXTRA_RRECOMMENDS = " kernel-modules ti-sgx-ddk-km amx3-cm3"

RDEPENDS_${PN}_remove = "nfs-utils"

# Allow for MMC booting (required by the NAND-less Beagleboard XM)
EXTRA_IMAGEDEPENDS += "u-boot"

# Uncomment the following line to enable the hard floating point abi. Note that
# this breaks some binary libraries and 3D (neither of which ship with
# meta-yocto). For maximum compatibility, leave this disabled.
DEFAULTTUNE ?= "cortexa8thf-neon"
include conf/machine/include/tune-cortexa8.inc

IMAGE_FSTYPES += "tar.bz2 ubi"
EXTRA_IMAGECMD_jffs2 = "-lnp "

# Add wic sdcard image file
require conf/machine/cl_wic.inc
# We do want to mount the /boot directory for 335x
WKS_FILE = "sdimage-bootpart.wks"

# 2.6.37 and later kernels use OMAP_SERIAL, ttyO2
# earlier kernels use ttyS2
SERIAL_CONSOLE = "115200 ttyO0"

PREFERRED_PROVIDER_virtual/kernel ?= "linux-mitysom335x-devkit"
PREFERRED_VERSION_linux-mitysom335x-devkit ?= "4.19%"
PREFERRED_VERSION_linux-mitysom335x-tiwi ?= "4.19%"

KERNEL_IMAGETYPES = "zImage fitImage"
UBOOT_LOADADDRESS = "0x82000000"
ENTRYPOINT = "0x82000000"

PREFERRED_PROVIDER_virtual/bootloader ?= "u-boot-mitysom-335x"
PREFERRED_PROVIDER_u-boot ?= "u-boot-mitysom-335x"

GUI_MACHINE_CLASS = "smallscreen"

# Specify SGX SDK version
#PREFERRED_VERSION_omap3-sgx-modules = "4.09.00.01"
#PREFERRED_VERSION_libgles-omap3 = "4.09.00.01"

# Specify libgles drivers over mesa
PREFERRED_PROVIDER_virtual/egl = "ti-sgx-ddk-um"
PREFERRED_PROVIDER_virtual/libgles1 = "ti-sgx-ddk-um"
PREFERRED_PROVIDER_virtual/libgles2 = "ti-sgx-ddk-um"
PREFERRED_PROVIDER_virtual/libgl = "ti-sgx-ddk-um"
PREFERRED_PROVIDER_virtual/mesa ?= "ti-sgx-ddk-um"
PACKAGECONFIG_GL = " gles2 "

# Eliminates multiple jpeg providers warnings
PREFERRED_PROVIDER_jpeg ?= "jpeg"
PREFERRED_PROVIDER_jpeg-native ?= "jpeg-native"

MACHINE_FEATURES = "usbgadget usbhost vfat alsa ext2 opkg screen touchscreen ethernet sgx bluetooth canbus flash i2c rs485 wireless"

ANGSTROM_FEED_ARCH = "armv7at2hf-vfp-neon"
HOST_ARCH = "arm"

# These are the UBI settings for the 256MB NAND 
MKUBIFS_ARGS ?= " -F -m 2048 -e 126976 -c 3149 "
UBINIZE_ARGS ?= " -p 128KiB -m 2048 -s 2048 "

# Do not install kernel into root partition.
RDEPENDS_${KERNEL_PACKAGE_NAME}-base = ""
```

## conf/machine/mitysom_335x.conf
```bitbake
#@TYPE: Machine
#@NAME: mitysom_335x

#@DESCRIPTION: Machine configuration for mitysom_335x systems
SOC_FAMILY = "ti33x"
require conf/machine/include/soc-family.inc

PREFERRED_PROVIDER_virtual/xserver ?= "xserver-xorg"
XSERVER ?= "xserver-xorg \
           xf86-input-evdev \
           xf86-input-mouse \
           xf86-video-fbdev \
           xf86-input-keyboard \
           xf86-input-tslib"

# Ship all kernel modules by default
MACHINE_EXTRA_RRECOMMENDS = " kernel-modules"

# Allow for MMC booting (required by the NAND-less Beagleboard XM)
EXTRA_IMAGEDEPENDS += "u-boot"

# Uncomment the following line to enable the hard floating point abi. Note that
# this breaks some binary libraries and 3D (neither of which ship with
# meta-yocto). For maximum compatibility, leave this disabled.
DEFAULTTUNE ?= "cortexa8hf-neon"
include conf/machine/include/tune-cortexa8.inc

IMAGE_FSTYPES += "tar.bz2 jffs2"
EXTRA_IMAGECMD_jffs2 = "-lnp "

# 2.6.37 and later kernels use OMAP_SERIAL, ttyO2
# earlier kernels use ttyS2
SERIAL_CONSOLE = "115200 ttyO0"

PREFERRED_PROVIDER_virtual/kernel ?= "linux-mitysom335x"


KERNEL_IMAGETYPE = "uImage"

PREFERRED_PROVIDER_u-boot = "u-boot-mitysom"

SPL_BINARY = "MLO"
UBOOT_SUFFIX = "img"
UBOOT_MACHINE = "mityarm335x"
UBOOT_ENTRYPOINT = "0x80008000"
UBOOT_LOADADDRESS = "0x80008000"

GUI_MACHINE_CLASS = "smallscreen"
PREFERRED_VERSION_omap3-sgx-modules = "4.09.00.01"
PREFERRED_VERSION_libgles-omap3 = "4.09.00.01"

MACHINE_FEATURES = "usbgadget usbhost vfat alsa ext2 screen touchscreen ethernet sgx"
```
